/* Copyright (c) 2012, Code Aurora Forum. All rights reserved.
 *
 * This program is free software; you can redistribute it and/or modify
 * it under the terms of the GNU General Public License version 2 and
 * only version 2 as published by the Free Software Foundation.
 *
 * This program is distributed in the hope that it will be useful,
 * but WITHOUT ANY WARRANTY; without even the implied warranty of
 * MERCHANTABILITY or FITNESS FOR A PARTICULAR PURPOSE.  See the
 * GNU General Public License for more details.
 */

/dts-v1/;

/include/ "../msm8974-lge-common/msm8974-lge.dtsi"
/include/ "msm8974-t1-global_com.dtsi"

/ {
	model = "Qualcomm MSM 8974 T1 GLOBAL COM";
	compatible = "qcom,msm8974";
	/*
		MSM8974		= 126,
		APQ8074		= 184,
		MSM8974AA	= 217,
		MSM8974AB	= 218,
		MSM8974AC	= 194,
		APQ8074AA	= 208,
		APQ8074AB	= 209,
		APQ8074AC	= 210,
	*/
	qcom,msm-id = <126 180 0>, <217 180 0>, <218 180 0>, <194 180 0>, <184 180 0>, <208 180 0>, <209 180 0>, <210 180 0>;
};

