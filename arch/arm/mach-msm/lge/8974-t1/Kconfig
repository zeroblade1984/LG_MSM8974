## arch/arm/mach-msm/lge/8974-t1/Kconfig
```kconfig
config MACH_MSM8974_T1
	bool

config MACH_MSM8974_T1_ATT
	depends on ARCH_MSM8974
	select MACH_LGE
	select MACH_MSM8974_T1
	bool "MSM8974 T1 ATT"
	help
	  Support for the Qualcomm MSM8974 T1 AT&T device.

config MACH_MSM8974_T1_USC
	depends on ARCH_MSM8974
	select MACH_LGE
	select MACH_MSM8974_T1
	bool "MSM8974 T1 USC"
	help
	  Support for the Qualcomm MSM8974 T1 USC device.

config MACH_MSM8974_T1LTE_GLOBAL_COM
    depends on ARCH_MSM8974
    select MACH_LGE
    select MACH_MSM8974_T1
    bool "MSM8974 T1 GLOBAL COM"
    help
        Support for the Qualcomm MSM8974 T1LTE Global Com device.

config MACH_MSM8974_T1WIFI_GLOBAL_COM
    depends on ARCH_MSM8974
    select MACH_LGE
    select MACH_MSM8974_T1
    bool "MSM8974 T1WIFI GLOBAL COM"
    help
        Support for the Qualcomm MSM8974 T1WIFI Global Com device.

config MACH_MSM8974_T1WIFIN_GLOBAL_COM
    depends on ARCH_MSM8974
    select MACH_LGE
    select MACH_MSM8974_T1
    bool "MSM8974 T1WIFIN GLOBAL COM"
    help
        Support for the Qualcomm MSM8974 T1WIFIN Global Com device.
```

## fs/ecryptfs/Kconfig
```kconfig
config ECRYPT_FS
	tristate "eCrypt filesystem layer support (EXPERIMENTAL)"
	depends on EXPERIMENTAL && KEYS && CRYPTO && (ENCRYPTED_KEYS || ENCRYPTED_KEYS=n)
	select CRYPTO_ECB
	select CRYPTO_CBC
	select CRYPTO_MD5
	help
	  Encrypted filesystem that operates on the VFS layer.  See
	  <file:Documentation/filesystems/ecryptfs.txt> to learn more about
	  eCryptfs.  Userspace components are required and can be
	  obtained from <http://ecryptfs.sf.net>.

	  To compile this file system support as a module, choose M here: the
	  module will be called ecryptfs.
config SD_ENCRYPTION_MANAGER
	bool "Enable LG SDCard encryption for media exception/decryption only"
	depends on ECRYPT_FS
	help
	  LG provides SD card encryption to protect external SD card data.
	  all created data on the external SD card is automatically encrypted by
	  file system (eCryptfs) before committing it to SD card and all reads
	  automatically decrypt data before returning it to the calling process.
```
